## conf/layer.conf
```bitbake
# We have a conf and classes directory, add to BBPATH
BBPATH .= ":${LAYERDIR}"

# We have recipes-* directories, add to BBFILES
BBFILES += "${LAYERDIR}/recipes-*/*/*.bb \
	${LAYERDIR}/recipes-*/*/*.bbappend"

BBFILE_COLLECTIONS += "u-boot-rpi2"
BBFILE_PATTERN_u-boot-rpi2 = "^${LAYERDIR}/"
BBFILE_PRIORITY_u-boot-rpi2 = "10"
```
